## app/Kconfig
```kconfig
config APP_HEARTBEAT_PERIOD_MS
	int "Blink period (ms)"
	default 500
	range 100 2000


source "Kconfig.zephyr"
```

## boards/custom_nucleo/Kconfig.defconfig
```kconfig
# NUCLEO-144 F429ZI board configuration

# Copyright (c) 2017 Linaro Limited
# SPDX-License-Identifier: Apache-2.0

if BOARD_CUSTOM_NUCLEO

configdefault ETH_DRIVER
	default y

endif # BOARD_CUSTOM_NUCLEO
```

## boards/custom_nucleo/board.yml
```yaml
board:
  name: custom_nucleo
  full_name: Custom_Nucleo F429ZI
  vendor: st
  socs:
    - name: stm32f429xx
```

## boards/scratch_nucleo/Kconfig.defconfig
```kconfig
if BOARD_SCRATCH_NUCLEO


config ETH_DRIVER
	default y



endif # BOARD_SCRATCH_NUCLEO
```

## boards/scratch_nucleo/board.yml
```yaml
board: 
  name: scratch_nucleo
  full_name: Nucleo board from scratch
  vendor: iomico
  socs:
    - name: stm32f429xx
```
